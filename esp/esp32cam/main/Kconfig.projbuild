## esp/esp32cam/main/Kconfig.projbuild
```kconfig
menu "ESP32-CAM Web Server"
    config CAM_WIFI_SSID
        string "Wi-Fi SSID"
        default "YOUR_WIFI_SSID"
    config CAM_WIFI_PASSWORD
        string "Wi-Fi password"
        default "YOUR_WIFI_PASSWORD"
endmenu
```

## esp/esp32cam/sdkconfig.defaults
```kconfig
CONFIG_ESPTOOLPY_FLASHSIZE_4MB=y
CONFIG_SPIRAM=y
CONFIG_SPIRAM_MODE_OCT=y
CONFIG_SPIRAM_SPEED_40M=y
CONFIG_SPIRAM_BOOT_INIT=y
CONFIG_PARTITION_TABLE_SINGLE_APP_LARGE=y
CONFIG_ESP_MAIN_TASK_STACK_SIZE=8192
```
